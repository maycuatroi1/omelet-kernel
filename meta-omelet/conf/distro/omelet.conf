## meta-omelet/conf/distro/omelet.conf
```bitbake
# Omelet distro - poky with systemd + branding for the Omelet kernel project.

# Must be set BEFORE requiring poky.conf, which includes
# conf/distro/include/init-manager-${INIT_MANAGER}.inc at parse time.
INIT_MANAGER = "systemd"

require conf/distro/poky.conf

DISTRO = "omelet"
DISTRO_NAME = "Omelet"
DISTRO_VERSION = "1.0"
DISTRO_CODENAME = "omelet"
MAINTAINER = "Omelet <socrat.nguyenanhbinh@gmail.com>"
TARGET_VENDOR = "-omelet"
SDK_VENDOR = "-omeletsdk"

# /usr merge; systemd itself is pulled in by the init-manager include above.
DISTRO_FEATURES:append = " usrmerge"
```

## meta-omelet/conf/layer.conf
```bitbake
# Layer configuration for meta-omelet
BBPATH .= ":${LAYERDIR}"

BBFILES += "${LAYERDIR}/recipes-*/*/*.bb \
            ${LAYERDIR}/recipes-*/*/*.bbappend"

BBFILE_COLLECTIONS += "meta-omelet"
BBFILE_PATTERN_meta-omelet = "^${LAYERDIR}/"
BBFILE_PRIORITY_meta-omelet = "10"

# networking-layer = meta-networking, provides NetworkManager (WiFi control).
LAYERDEPENDS_meta-omelet = "core raspberrypi networking-layer"
LAYERSERIES_COMPAT_meta-omelet = "scarthgap"
```
